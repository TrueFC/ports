## sysutils/u-boot-pinebook-pro/files/patch-configs_pinebook-pro-rk3399__defconfig
```kconfig
--- configs/pinebook-pro-rk3399_defconfig.org	2021-02-03 10:14:18.604110000 +0900
+++ configs/pinebook-pro-rk3399_defconfig	2021-02-03 10:21:15.411616000 +0900
@@ -22,6 +22,7 @@
 CONFIG_SPL_MTD_SUPPORT=y
 CONFIG_SPL_SPI_LOAD=y
 CONFIG_TPL=y
+CONFIG_CMD_BMP=y
 CONFIG_CMD_BOOTZ=y
 CONFIG_CMD_GPIO=y
 CONFIG_CMD_GPT=y
@@ -81,9 +82,13 @@
 CONFIG_USB_HOST_ETHER=y
 CONFIG_USB_ETHER_ASIX=y
 CONFIG_USB_ETHER_RTL8152=y
+CONFIG_USE_PREBOOT=y
 CONFIG_DM_VIDEO=y
 CONFIG_DISPLAY=y
-CONFIG_VIDEO_ROCKCHIP=y
 CONFIG_DISPLAY_ROCKCHIP_EDP=y
+CONFIG_VIDEO_BPP8=y
+CONFIG_VIDEO_BPP16=y
+CONFIG_VIDEO_BPP32=y
+CONFIG_VIDEO_ROCKCHIP=y
 CONFIG_SPL_TINY_MEMSET=y
 CONFIG_ERRNO_STR=y
```
